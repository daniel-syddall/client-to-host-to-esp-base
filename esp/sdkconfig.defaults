## esp/sdkconfig.defaults
```kconfig
# ESP-IDF SDK defaults for this project.
# These are applied on top of the chip defaults when running `idf.py set-target`.
# Override any value here to avoid modifying the generated sdkconfig.

# ── Console ───────────────────────────────────────────────────────────────── #
#
# No console override needed.  The protocol uses UART1 on GPIO43/44, which
# is independent of whichever UART the IDF console occupies (UART0 by default).
# Bootloader and IDF log output continue to work normally on UART0.

# ── FreeRTOS ──────────────────────────────────────────────────────────────── #

# 1 kHz tick rate (1 ms resolution).
CONFIG_FREERTOS_HZ=1000

# ── Logging ───────────────────────────────────────────────────────────────── #

# Default log level: INFO in production, DEBUG during development.
CONFIG_LOG_DEFAULT_LEVEL_INFO=y
# CONFIG_LOG_DEFAULT_LEVEL_DEBUG=y

# ── Flash size ────────────────────────────────────────────────────────────── #

CONFIG_ESPTOOLPY_FLASHSIZE_4MB=y

# ── Watchdog ──────────────────────────────────────────────────────────────── #

# Disable the task watchdog on the idle task so long-running serial reads
# don't trigger a reset during development.
CONFIG_ESP_TASK_WDT_EN=n
```
